////with out load cell/////

#include <WiFiManager.h> // https://github.com/tzapu/WiFiManager
#include "SPI.h"
#include "TFT_22_ILI9225.h"
#include <Keypad.h>
#include "FirebaseESP32.h"
#include "HX711.h"
#include <EEPROM.h>

////////ili9925_define//////////
#define TFT_RST 17  // IO 26
#define TFT_RS  16  // IO 25
#define TFT_CLK 18  // HSPI-SCK
#define TFT_SDI 23  // HSPI-MOSI
#define TFT_CS  5  // HSPI-SS0
#define TFT_LED 0   // 0 if wired to +5V directly
SPIClass vspi(VSPI);
#define TFT_BRIGHTNESS 0 // Initial brightness of TFT backlight (optional)
TFT_22_ILI9225 tft = TFT_22_ILI9225(TFT_RST, TFT_RS, TFT_CS, TFT_LED, TFT_BRIGHTNESS);

/////keypad_define///////
const byte numRows= 4;
const byte numCols= 4;
char keymap[numRows][numCols]= 
{ {'1', '2', '3', 'A'},
  {'4', '5', '6', 'B'},
  {'7', '8', '9', 'C'},
  {'*', '0', '#', 'D'}};
byte rowPins[numRows] = {12,14,27,26}; //Rows 0 to 3
byte colPins[numCols]= {25,33,32,15}; //Columns 0 to 3
Keypad myKeypad= Keypad(makeKeymap(keymap), rowPins, colPins, numRows, numCols);

WiFiManager wm;


//////Image////////
static const uint8_t PROGMEM get_user[] =
{
  0x00, 0x00, 0x00, 0x00, 0x00, 0x00, 0x00, 0x00, 0x00, 0x00, 0x00, 0x7F, 0xE0, 0x00, 0x00, 0x00, 
  0x00, 0x00, 0x00, 0xFF, 0xF8, 0x00, 0x00, 0x00, 0x00, 0x00, 0x07, 0xFF, 0xFF, 0x00, 0x00, 0x00, 
  0x00, 0x00, 0x3F, 0xFF, 0xFF, 0xC0, 0x00, 0x00, 0x00, 0x00, 0xFF, 0xFF, 0xFF, 0xF0, 0x00, 0x00, 
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  0x00, 0x00, 0x00, 0x3F, 0xC0, 0x00, 0x00, 0x00, 
};

static const uint8_t PROGMEM normal[] = 
{
  0x00, 0x00, 0x00, 0x00, 0x07, 0xF0, 0x00, 0x00, 0x00, 0x00, 0x00, 0x00, 0x00, 0x00, 0x0F, 0xF8, 
  0x00, 0x00, 0x00, 0x00, 0x00, 0x00, 0x00, 0x00, 0x1F, 0xF8, 0x00, 0x00, 0x00, 0x00, 0x00, 0x00, 
  0x00, 0x00, 0x1F, 0xF8, 0x00, 0x00, 0x00, 0x00, 0x00, 0x00, 0x00, 0x00, 0x1F, 0xFC, 0x00, 0x00, 
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  0xC0, 0x00, 0x00, 0x00, 
};

static const uint8_t PROGMEM under[] = 
{
  0x00, 0x00, 0x00, 0x00, 0x07, 0xE0, 0x00, 0x00, 0x00, 0x00, 0x00, 0x00, 0x00, 0x00, 0x0F, 0xF0, 
  0x00, 0x00, 0x00, 0x00, 0x00, 0x00, 0x00, 0x00, 0x0F, 0xF0, 0x00, 0x00, 0x00, 0x00, 0x00, 0x00, 
  0x00, 0x00, 0x1F, 0xF0, 0x00, 0x00, 0x00, 0x00, 0x00, 0x00, 0x00, 0x00, 0x1F, 0xF8, 0x00, 0x00, 
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  0x00, 0x00, 0x00, 0x00, 
};

static const uint8_t PROGMEM over[] = 
{
  0x00, 0x00, 0x00, 0x00, 0x07, 0xF0, 0x00, 0x00, 0x00, 0x00, 0x00, 0x00, 0x00, 0x00, 0x0F, 0xF8, 
  0x00, 0x00, 0x00, 0x00, 0x00, 0x00, 0x00, 0x00, 0x1F, 0xF8, 0x00, 0x00, 0x00, 0x00, 0x00, 0x00, 
  0x00, 0x00, 0x1F, 0xFC, 0x00, 0x00, 0x00, 0x00, 0x00, 0x00, 0x00, 0x00, 0x1F, 0xFC, 0x00, 0x00, 
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  0xC0, 0x00, 0x00, 0x00, 
};

static const uint8_t PROGMEM obese[] = 
{
  0x00, 0x00, 0x00, 0x00, 0x07, 0xF0, 0x00, 0x00, 0x00, 0x00, 0x00, 0x00, 0x00, 0x00, 0x1F, 0xF8, 
  0x00, 0x00, 0x00, 0x00, 0x00, 0x00, 0x00, 0x00, 0x1F, 0xFC, 0x00, 0x00, 0x00, 0x00, 0x00, 0x00, 
  0x00, 0x00, 0x3F, 0xFC, 0x00, 0x00, 0x00, 0x00, 0x00, 0x00, 0x00, 0x00, 0x3F, 0xFC, 0x00, 0x00, 
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  0xF0, 0x00, 0x00, 0x00, 
};


///firebase_define//////
#define FIREBASE_HOST "https://test-mainproject-2df90.firebaseio.com" //Do not include https:// in FIREBASE_HOST
#define FIREBASE_AUTH "6LrHrZjSkYt9CXYEDIPbk6e8nHmpDIQ9rbSuynZ6"

////////hx711_define//////////
#define DOUT  21  
#define CLK  22
HX711 scale(DOUT, CLK);

//////delay_define////////
#define relay_pin_vcc 13

//Variables and constants
int16_t x=0, y=0, w, h;
bool res;
int show = 0;
int select_mode = 0;
int first = 0;
String phonenum ="";
int count_time = 0;
int count_loop = 0;
String compareweight[5];
String SWeight="";
bool led = false;
int state = 0;
String hight = "";
float weight = 0.0;
int renew = 99;
int sw_to = 99; //1 online , 2 offline
unsigned long previousTime = 0;
int set_tomills = 0;
float sent_wei = 0.0;
String read_wifi_name = "";
String read_wifi_pass = "";
String wifi_name = "";
String wifi_pass = "";

String convertFloatToString(float f)
{
  String s = String(f,1);
  return s;
}

void writeUsertoEEPROM()
{
  for(int i=0;i<wifi_name.length();i++)
  {
    Serial.println(wifi_name[i]);
    EEPROM.write(i,wifi_name[i]);
  }
  EEPROM.write(wifi_name.length(),'\0');
  EEPROM.commit();
}

void writePasstoEEPROM()
{
  int addr = wifi_name.length() + 1;
  for(int i=0;i<wifi_pass.length();i++)
  {    
    Serial.println(wifi_pass[i]);
    EEPROM.write(addr,wifi_pass[i]);
    addr++;
  }
  EEPROM.write((wifi_pass.length()+wifi_name.length())+1,'\0');
  EEPROM.commit();
}

void readUsertoEEPROM()
{
   int i = 0;
   while(1)
   {    
    char c = EEPROM.read(i);    
    Serial.println(c);
    read_wifi_name.concat(c);    
    if(c == '\0')
    {
      return;
    }
    i++;   
  } 
}

void readPasstoEEPROM()
{
   int i = read_wifi_name.length();
   while(1)
   {    
    char c = EEPROM.read(i);
    Serial.println(c);
    read_wifi_pass.concat(c);
    if(c == '\0')
    {
      return;
    }
    i++;   
  } 
}

void read_serial() //set load cell 
{
  char read_input = Serial.read();
  if(read_input == 'w')
  {
      weight = 20.0;
      return;
  }else if(read_input == 'q')
  {
      weight = 0.0;
      return;
  }
  else if(read_input == 'e')
  {
      weight = 50.0;
      return;
  }
  else if(read_input == 'c')
  {
      weight = 2.00;
      return;  
  }    
}

void start_led()
{
  digitalWrite(relay_pin_vcc, HIGH);
  vspi.begin();  
  tft.begin(vspi);
  tft.setOrientation(3);
  led = true;
  first = 0;
  show = 0;
  return;
}

void wifimanagerwithcheck(){
  if(WiFi.status() != WL_CONNECTED){
      tft.clear();      
      delay(2000);
      tft.setFont(Terminal11x16);
      tft.drawText(15, 20, "WiFi Not Connect !!!");
      tft.drawText(5, 40, "Please Put Your Phone");
      tft.drawText(25, 60, "And Connect WiFi"); 
      tft.drawText(25, 90, "Name: ConfigWiFi");
      tft.drawText(25, 110,"Pass: pty7xkusrc");
      tft.drawText(13, 140, "For Config WiFi Base");
      res = wm.autoConnect("ConfigWiFi","pty7xkusrc");
      wifi_name = wm.getSSID();
      wifi_pass = wm.getPassword();
      Serial.println(wifi_name);
      Serial.println(wifi_pass);
      writeUsertoEEPROM();
      writePasstoEEPROM();
 }
 else{
     tft.clear();      
     delay(2000);
     display_wificonnect();
  }
}

void display_wificonnect(){
     if(first == 1){
     tft.clear();
     tft.drawText(30, 80, "WiFi Connect !!!");   
     delay(4000);
     first == 3;
     return;
   }  
}

void display_first(){
  if(first == 0){
      tft.setFont(Terminal11x16);
      tft.drawText(60, 60, "Welcome To");
      tft.drawText(50, 80, "SMART Weight");
      tft.drawText(30, 100, "And Analyeze BMI");    
      delay(5000);
      first = 1;
      return; 
    }
  }

void selectmode(){
    while(true){
    char keypressed = myKeypad.getKey();
    unsigned long showTime = millis();
    if(set_tomills == 0){
      previousTime = showTime;
      set_tomills = 1;
    }    
       if(show == 0){
        tft.clear();        
        Serial.println("Clear_SelectMode");
        tft.setFont(Terminal11x16);    
        tft.drawText(10, 20, "Please Press \"A\" , \"B\"");
        tft.drawText(35, 40, "For Select Mode");
        tft.drawText(58, 100, "A");
        tft.drawText(30, 120, "Online");
        tft.drawText(160, 100, "B");  
        tft.drawText(130, 120, "Offline");
        show = 1;
      }    
    if(keypressed == 'A'){
      show = 0;
      select_mode = 1;
      sw_to = 1;
      set_tomills = 0;
      return;
    }
    else if(keypressed == 'B'){
      show = 0;
      select_mode = 2;
      sw_to = 2;
      state = 88;
      set_tomills = 0;
      return;
    }
    else if(keypressed == NO_KEY){
      Serial.println(showTime / 1000);
      if(showTime - previousTime == 10000)
      {        
        digitalWrite(relay_pin_vcc, LOW);
        Serial.println("LCD_OFF");
        led = false;
        sw_to = 99;
        set_tomills = 0;
        return;
      }     
    }
  }
}

void display_phonenumbertofirebase(){
        if(show == 0){
          tft.clear();
          put_phonenum();        
          while(true){
          char keypressed = myKeypad.getKey();  
            if (keypressed != NO_KEY && phonenum.length() < 5){
                if(keypressed == 'A'){
                    phonenum = "";
                    tft.clear();
                    put_phonenum();               
               }else{
                    phonenum += keypressed;
                    tft.setFont(Terminal11x16);        
                    tft.drawText(50, 70, phonenum);
                    Serial.print("size : ");
                    Serial.println(phonenum.length());    
            } 
          }
        else if(keypressed == '#' && phonenum.length() == 5){
            tft.clear();
            for(int i =0;i<=5;i++){
              if(phonenum[i] == 'B' || phonenum[i] == 'C' || phonenum[i] == 'D' || phonenum[i] == '*' || phonenum[i] == '#'){
                 Serial.println("FOUND");
                 phonenum = "";                 
                 tft.clear();
                 put_phonenum();                                 
              }              
            }
            Serial.print("exit_phonenum : ");
            Serial.println(phonenum); 
            display_getuser();
            show = 1;
            count_time = 0;
            state = 88;    
            return;                                    
          }
        }        
  }
}

void put_phonenum(){
  tft.fillCircle(210, 5, 5, COLOR_GREEN);
  tft.setFont(Terminal6x8);
  tft.drawText(164, 1, "Online");   
  tft.setFont(Terminal11x16);
  tft.drawText(10, 15, "Put Your Student ID");
  tft.drawText(20, 123, "Press \"A\" to Clear");
  tft.drawText(20, 143, "Press \"#\" to Next");
  return; 
}

void display_getuser()
{
  Serial.print("phonenum : ");
  Serial.println(phonenum); 
  String path_to_name = "/User/"+phonenum+"/name";
  String path_to_age = "/User/"+phonenum+"/age";
  String uname ="";
  String uage ="";
  FirebaseData firebaseData;
  Firebase.begin(FIREBASE_HOST, FIREBASE_AUTH); 
  Firebase.reconnectWiFi(true);
  if (Firebase.getString(firebaseData, path_to_name)) {
    if (firebaseData.dataType() == "string") {
      uname = firebaseData.stringData();
      Serial.println(uname);      
    }
  } else {
    Serial.println(firebaseData.errorReason());
  } 
 if (Firebase.getInt(firebaseData, path_to_age)) {
    if (firebaseData.dataType() == "int") {
      uage = String(firebaseData.intData());  
      Serial.println(uage);          
    }
  } else {
    Serial.println(firebaseData.errorReason());
  }
 if(uname != "" && uage != "")
 {
  tft.fillCircle(210, 5, 5, COLOR_GREEN);
  tft.setFont(Terminal6x8);
  tft.drawText(164, 1, "Online");   
  tft.setFont(Terminal11x16);
  tft.drawBitmap(20, 50, get_user, 60, 57,COLOR_WHITE);
  tft.drawText(100, 65, "Name :");
  tft.drawText(100, 95, "Age :");
  tft.drawText(160, 65, uname);
  tft.drawText(160, 95, uage);
  delay(8000);
  return;   
 }
}

void put_tofirebase()
{
  FirebaseData firebaseData;
  Firebase.begin(FIREBASE_HOST, FIREBASE_AUTH); 
  Firebase.reconnectWiFi(true);   
  String path_to_weight = "/User/"+phonenum+"/weight";
   if (Firebase.setInt(firebaseData, path_to_weight , sent_wei))
    {
      if (firebaseData.dataType() == "float")
        Serial.println(firebaseData.floatData(), 5);
        phonenum = "";
        return;
    }
   
}

void display_showbmi(int sumshow,String strsum)
{
  if(sumshow <= 18.5)
  {
    tft.setFont(Terminal11x16);
    tft.drawText(140, 60, "BMI");
    tft.drawText(140, 90, strsum);  
    tft.drawBitmap(20, 40, under, 80, 90,COLOR_CYAN);   
    tft.drawText(35, 145, "Under");   
  }
  else if(sumshow > 18.5 && sumshow <= 24.9)
  {
    tft.setFont(Terminal11x16);
    tft.drawText(140, 60, "BMI");
    tft.drawText(135, 90, strsum);  
    tft.drawBitmap(20, 40, normal, 80, 90,COLOR_GREEN);   
    tft.drawText(30, 145, "Healthy");   
  }
  else if(sumshow > 24.9 && sumshow <= 29.9)
  {
    tft.setFont(Terminal11x16);
    tft.drawText(140, 60, "BMI");
    tft.drawText(135, 90, strsum);  
    tft.drawBitmap(20, 40, over, 80, 90,COLOR_ORANGE);   
    tft.drawText(40, 145, "Over");
  }
  else if(sumshow > 29.9)
  {
    tft.setFont(Terminal11x16);
    tft.drawText(140, 60, "BMI");
    tft.drawText(135, 90, strsum);  
    tft.drawBitmap(20, 40, obese, 80, 90,COLOR_RED);   
    tft.drawText(35, 145, "Obese");    
  }  
    
}

void passtobmiShow(){
  while(true){
   //time_h = millis();
   //Serial.print("Time_h : ");
   //Serial.println(time_h);   
   if(state == 99){
      tft.clear();
      display_status();
      tft.setFont(Terminal11x16);
      tft.drawText(85, 5, "Height");
      tft.drawText(25, 150, "Please Input Data");
      tft.drawText(198, 110, "cm");      
      state = 88;
    }  
  char keypressed = myKeypad.getKey();  
  if (keypressed != NO_KEY && hight.length() < 3){
    if(keypressed == 'A'){
      clear_hight();
    }else{
      hight += keypressed;
      tft.setFont(DSEG7_Modern53x72);        
      tft.drawText(5, 50, hight);
      Serial.print("size : ");
      Serial.println(hight.length());    
   } 
  }
  else if(keypressed == '#' && hight.length() == 3){
    for(int i =0;i<=3;i++){
      if(hight[i] == 'B' || hight[i] == 'C' || hight[i] == 'D' || hight[i] == '*' || hight[i] == '#'){
         Serial.println("FOUND");
         renew = 1;
         clear_hight();                  
        }      
      }
    if(renew == 99 && hight.length() == 3){
      float sum = 0.0;
      float hight_float = 0.0;
      String sum_ss;
      sent_wei = weight; 
      display_status();
      Serial.print("hight  : ");
      Serial.println(hight);
      hight_float = hight.toFloat() / 100;
      Serial.print("hight /100 : ");
      Serial.println(hight_float);
      hight_float = pow(hight_float,2);
      Serial.print("hight ^2 : ");
      Serial.println(hight_float);
      sum = weight  / hight_float;
      Serial.print("BMI : ");
      Serial.println(sum);
      sum_ss = convertFloatToString(sum);
      tft.clear();
      display_status(); 
      display_showbmi(sum,sum_ss);
      if(sw_to == 1)
      {
       put_tofirebase(); 
      }      
      for(int i = 0;i<30;i++){
        Serial.print("i : ");
        Serial.println(i);
        if(i == 29){
            Serial.println(sizeof(compareweight));       
            hight = "";
            count_loop = 0;
            count_time = 0;
            weight = 0.0; //set load cell
            return;
          }
        delay(1000);      
      }     
    }  
  }
  else if(keypressed == 'A'){
    tft.clear();
    display_status();
    tft.setFont(Terminal11x16);
    tft.drawText(85, 5, "Height");
    tft.drawText(25, 150, "Please Input Data");
    tft.drawText(198, 110, "cm");
    hight = "";
    Serial.println("Clear");
    }
  }   
}

void clear_hight(){
    tft.clear();
    display_status();
    tft.setFont(Terminal11x16);
    tft.drawText(85, 5, "Height");
    tft.drawText(25, 150, "Please Input Data");
    tft.drawText(198, 110, "cm");
    hight = "";
    renew = 99;
    Serial.println("Clear");
}

void display_status()
{
  if(sw_to == 1) //online
  {
    tft.fillCircle(210, 5, 5, COLOR_GREEN);
    tft.setFont(Terminal6x8);
    tft.drawText(164, 1, "Online");
    return;   
  }
  else if(sw_to == 2) //offline
  {
   tft.fillCircle(210, 5, 5, COLOR_RED);
   tft.setFont(Terminal6x8);
   tft.drawText(159, 1, "Offline");
   return;  
  }  
}


void display_weight()
{
 while(true){
  Serial.println("input weight");  
  read_serial(); //scale.get_units();  
  SWeight = convertFloatToString(weight);
  Serial.println("in_dwo");
  Serial.println(state);
  if(weight >= 1 && weight < 10){ 
    if(state == 1 || state == 2 || state == -1 ){
             tft.clear();
             state = 0;
             count_loop = 0;
        }
        Serial.print("weight : ");
        Serial.println(weight);
        Serial.print("state : ");
        Serial.println(state);
        display_status(); 
        tft.setFont(Terminal11x16);
        tft.drawText(85, 5, "Weight");  
        tft.drawText(198, 110, "kg");
        tft.setFont(DSEG7_Modern53x72);
        tft.drawText(50, 50, SWeight);
        count_time = 0;           
        for(;count_loop<4;count_loop++){
          Serial.println("input weight");
          read_serial();//scale.get_units();
          SWeight = convertFloatToString(weight);
          compareweight[count_loop] = SWeight;
          Serial.print("In Compare : ");
          Serial.println(compareweight[count_loop]);
          if(compareweight[count_loop -1] == SWeight){                       
            tft.clear();
            display_status(); 
            tft.setFont(Terminal11x16);
            tft.drawText(85, 5, "Weight");
            tft.drawText(198, 110, "kg");
            tft.setFont(DSEG7_Modern53x72);        
            tft.drawText(50, 50, SWeight); 
            Serial.print("Blink : ");
            Serial.println(count_loop);
            compareweight[count_loop -1] = ""; 
            delay(1000);        
          }else{
            Serial.println("NNNNNNNNNNN");
            count_loop = 0;
            break;
          }
        }
        if(count_loop == 4){
            state = 99;
            passtobmiShow();
        } 
  }
  else if(weight >= 10 && weight < 100){
          if(state == 0 || state == -1 || state == 2){
            tft.clear();
            state = 1;
            count_loop = 0;
          }
        Serial.print("weight : ");
        Serial.println(weight);
        Serial.print("state : ");
        Serial.println(state);
        display_status();   
        tft.setFont(Terminal11x16);
        tft.drawText(85, 5, "Weight"); 
        tft.drawText(198, 110, "kg");
        tft.setFont(DSEG7_Modern53x72);        
        tft.drawText(5, 50, SWeight);
        count_time = 0;  
          for(;count_loop<4;count_loop++){
          Serial.println("input weight");  
          read_serial(); //scale.get_units();  
          SWeight = convertFloatToString(weight);
          compareweight[count_loop] = SWeight;
          Serial.print("In Compare : ");
          Serial.println(compareweight[count_loop]);
        if(compareweight[count_loop -1] == SWeight){                       
            tft.clear();
            display_status(); 
            tft.setFont(Terminal11x16);
            tft.drawText(85, 5, "Weight");
            tft.drawText(198, 110, "kg");
            tft.setFont(DSEG7_Modern53x72);        
            tft.drawText(5, 50, SWeight); 
            Serial.print("Blink : ");
            Serial.println(count_loop);
            delay(1000);          
          }else{
            Serial.println("NNNNNNNNNNN");
            count_loop = 0;
            break;
          }
        }
        if(count_loop == 4){
            state = 99;
            passtobmiShow();
          }       
   }
   else if (weight >= 100 && weight < 200){
          if(state == 0 || state == 1 || state == -1){
            tft.clear();
            state = 2;
            count_loop = 0;
        }        
        display_status();
        tft.setFont(Terminal11x16);
        tft.drawText(198, 110, "kg");
        tft.drawText(85, 5, "Weight");
        tft.setFont(DSEG7_Modern53x72);        
        tft.drawText(-35, 50, SWeight);
        count_time = 0;
          for(;count_loop<4;count_loop++){
          Serial.println("input weight");  
          read_serial(); //scale.get_units();  
          SWeight = convertFloatToString(weight);
          compareweight[count_loop] = SWeight;
          Serial.print("In Compare : ");
          Serial.println(compareweight[count_loop]);
        if(compareweight[count_loop -1] == SWeight){                       
            tft.clear();
            display_status();
            tft.setFont(Terminal11x16);
            tft.drawText(85, 5, "Weight");
            tft.drawText(198, 110, "kg");
            tft.setFont(DSEG7_Modern53x72);        
            tft.drawText(-35, 50, SWeight); 
            Serial.print("Blink : ");
            Serial.println(count_loop);
            delay(1000);          
          }else{
            Serial.println("NNNNNNNNNNN");
            count_loop = 0;
            break;
          }
        }
        if(count_loop == 4){
            state = 99;
            
            passtobmiShow();
          }                      
        }
        else{
      count_loop = 0;
        if(state == 1 || state == 0 || state == 2 || state == 88){
            tft.clear();
            state = -1;          
        }
        display_status(); 
        tft.setFont(Terminal11x16);        
        tft.drawText(85, 5, "Weight"); 
        tft.drawText(198, 110, "kg");         
        tft.setFont(DSEG7_Modern53x72);
        tft.drawText(50, 50, "0.0");
        for(int i = count_time;i<=30;i++){
                count_time++;
                 Serial.println("input weight");  
                 read_serial(); //scale.get_units();  
                if(weight >= 0.05){
                    count_time = 0;
                    break;
                }
                else if(i == 30){
                 sw_to = 99;
                 select_mode = 0;
                 show = 0;
                 return;
                }
           Serial.print("count_time : ");
           Serial.println(count_time);
           delay(1000);                
       }            
      }
  delay(500);      
  }
}

void setup() {
    Serial.begin(115200);    
    EEPROM.begin(512);
    vspi.begin();
    tft.begin(vspi);
    tft.setOrientation(3);   
    scale.set_scale(-12750.97);  // Start scale
    scale.tare();
    pinMode(relay_pin_vcc, OUTPUT);
    digitalWrite(relay_pin_vcc, LOW);
    readUsertoEEPROM();
    readPasstoEEPROM();
    Serial.println(read_wifi_name);
    Serial.println(read_wifi_pass);
    WiFi.begin(read_wifi_name.c_str(),read_wifi_pass.c_str()); 
}
void loop() {
    Serial.println("input weight_main_loop");  
    read_serial(); //scale.get_units();  
    Serial.println(weight);
    Serial.println(led);
    if(weight >= 1 && led == false){
      Serial.println("A");  
      weight = 0.0; //set load cell
      if(led == false){
        Serial.println("B");  
         start_led();
         display_first();
         selectmode();
         if(select_mode == 1){ //online
            wifimanagerwithcheck();
            display_wificonnect();  
            display_phonenumbertofirebase();       
            display_weight();                   
         }
         else if(select_mode == 2){ //offline 
          Serial.println("C");       
            display_weight();    
        }         
      }           
    }
    else if(led == true){  
      Serial.println("D");        
      selectmode();
    if(select_mode == 1){ //online
      Serial.println("E");     
      wifimanagerwithcheck();
      display_wificonnect();  
      display_phonenumbertofirebase();       
      display_weight();                   
    }
    else if(select_mode == 2){ //offline
      Serial.println("F");       
      display_weight();    
    }        
  }     
delay(500);
}
    
